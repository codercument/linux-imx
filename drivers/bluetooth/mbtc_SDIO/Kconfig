## drivers/bluetooth/mbtc_SDIO/Kconfig
```kconfig
config BT_SDIO_UART_CHAR
	tristate "Marvell UART OVER SDIO Bluetooth Driver for SD8786/SD8787/SD8797/SD8887/SD8897 --Kentkart Edition--"
	---help---
	  This adds support for bluetooth adapters based on Marvell
	  8786/8787/8797/8887/8897 chipsets with SDIO interface.

	  If you choose to build it as a module, it will be called
	  mbt8xxx.
```
